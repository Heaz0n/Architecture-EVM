	AREA    |.text|, CODE, READONLY
RCC_AHB1ENR           EQU 0x40021014
RCC_AHB1ENR_GPIOAEN   EQU 0x00020000 ; GPIOA
RCC_AHB1ENR_GPIOBEN   EQU 0x00040000 ; GPIOB

GPIOB_BASE            EQU 0x48000400
	; ????????
GPIO_MODER_OFFSET     EQU 0x00000000 ; GPIOx->MODER
GPIO_OTYPER_OFFSET    EQU 0x00000004 ; GPIOx->OTYPER
GPIO_OSPEEDR_OFFSET   EQU 0x00000008 ; GPIOx->OSPEEDR
GPIO_PUPDR_OFFSET     EQU 0x0000000C ; GPIOx->PUPDR
GPIO_IDR_OFFSET       EQU 0x00000010 ; GPIOx->IDR
GPIO_ODR_OFFSET       EQU 0x00000014 ; GPIOx->ODR
GPIO_BSRRL_OFFSET     EQU 0x00000018 ; GPIOx->BSRRL ?????
GPIO_BSRRH_OFFSET     EQU 0x0000001A ; GPIOx->BSRRH ?????????
GPIO_LCKR_OFFSET      EQU 0x0000001C ; GPIOx->LCKR
GPIO_AFRL_OFFSET      EQU 0x00000020 ; GPIOx->AFRL
GPIO_AFRH_OFFSET      EQU 0x00000024 ; GPIOx->AFRH
	
	
; GPIOx->MODER
; ?????: ???????? ?????
GPIO_MODER_MODER0_0   EQU 0x00000001
GPIO_MODER_MODER1_0   EQU 0x00000004
GPIO_MODER_MODER2_0   EQU 0x00000010
GPIO_MODER_MODER3_0   EQU 0x00000040
GPIO_MODER_MODER4_0   EQU 0x00000100
GPIO_MODER_MODER5_0   EQU 0x00000400
GPIO_MODER_MODER6_0   EQU 0x00001000
GPIO_MODER_MODER7_0   EQU 0x00004000
GPIO_MODER_MODER8_0   EQU 0x00010000
GPIO_MODER_MODER9_0   EQU 0x00040000
GPIO_MODER_MODER10_0  EQU 0x00100000
GPIO_MODER_MODER11_0  EQU 0x00400000
GPIO_MODER_MODER12_0  EQU 0x01000000
GPIO_MODER_MODER13_0  EQU 0x04000000
GPIO_MODER_MODER14_0  EQU 0x10000000
GPIO_MODER_MODER15_0  EQU 0x40000000

	END